/* Copyright (c) 2016, The Linux Foundation. All rights reserved.
 *
 * This program is free software; you can redistribute it and/or modify
 * it under the terms of the GNU General Public License version 2 and
 * only version 2 as published by the Free Software Foundation.
 *
 * This program is distributed in the hope that it will be useful,
 * but WITHOUT ANY WARRANTY; without even the implied warranty of
 * MERCHANTABILITY or FITNESS FOR A PARTICULAR PURPOSE.  See the
 * GNU General Public License for more details.
 */

/* Please modify i2c bus number according to your platform */
&i2c5 {
	sy697x@6a {
		compatible = "sy,sy6970";
		reg = <0x6a>;
		interrupt-parent = <&pio>;
		interrupts = <90 IRQ_TYPE_EDGE_FALLING 90 0>;
		sy,sy697x,usb-vlim =<4400>;
		sy,sy697x,precharge-current = <256>;
		sy,sy697x,termination-current = <250>;
		sy,sy697x,charge-detect-enable;

		/*
		 * Charger name
		 * Main charger: primary_chg
		 * Slave charger: secondary_chg
		 */
		charger_name = "primary_chg";
		status = "okay";
	};
};

