## Kconfig
```kconfig
# SPDX-License-Identifier: GPL-2.0
#
# For a description of the syntax of this configuration file,
# see Documentation/kbuild/kconfig-language.txt.
#
mainmenu "Linux/$(ARCH) $(KERNELVERSION) Kernel Configuration"

config OPLUS_FEATURE_PANIC_FLUSH
	bool "fsync optimization "
	default y
	help
		define this config to fsync optimization

comment "Compiler: $(CC_VERSION_TEXT)"

source "scripts/Kconfig.include"

source "init/Kconfig"

source "kernel/Kconfig.freezer"

source "fs/Kconfig.binfmt"

source "mm/Kconfig"

source "net/Kconfig"

source "drivers/Kconfig"

source "fs/Kconfig"

source "security/Kconfig"

source "crypto/Kconfig"

source "lib/Kconfig"

source "lib/Kconfig.debug"
```

## drivers/power/Kconfig
```kconfig
source "drivers/power/avs/Kconfig"
source "drivers/power/reset/Kconfig"
source "drivers/power/supply/Kconfig"

#ifdef OPLUS_FEATURE_CHG_BASIC
source "drivers/power/oplus/Kconfig"

config OPLUS_CHARGER
	bool "OPLUS_CHARGER"
	default n
	help
	  Set Yes to support OPLUS_CHARGER features
	  smart battery.
	  Set No to disable OPLUS_CHARGER features
	  smart battery.

config OPLUS_CHARGER_MTK
	bool "OPLUS charger on MTK"
	default n
	help
	  Say Yes here to declare charging system is on MTK
	  Say No here to declare charging system is not on MTK

config OPLUS_CHARGER_MTK_CHGIC
	bool "OPLUS_CHARGER_MTK_CHG_IC"
	default n
	help
	  Say Yes to use MTK platform charger ic
	  Say No to use extern charger ic


config OPLUS_CHARGER_MTK6779R
	bool "OPLUS_CHARGER_MTK6779"
	default n
	help
	  Set yes to support OPLUS_CHARGER_MTK6779 features
	  smart battery.
	  Set No to disable OPLUS_CHARGER_MTK6779 features
	  smart battery.

config OPLUS_CHARGER_MTK6765R
	bool "OPLUS_CHARGER_MTK6765R"
	default n
	help
	  Set yes to support OPLUS_CHARGER_MTK6765 features
	  smart battery.
	  Set No to disable OPLUS_CHARGER_MTK6765 features
	  smart battery.

config OPLUS_CHARGER_MATCH_MTKGAUGE
	bool "OPLUS_CHARGER_MATCH_MTKGAUGE"
	default n
	help
	  Set yes to support use mtk gauge and not use mtk charger features
	  smart battery.
	  Set No to disable OPLUS_CHARGER_MATCH_MTKGAUGE features

config OPLUS_CHARGER_MTKAGING
	bool "OPLUS_CHARGER_MTKAGING"
	default n
	help
	  Set yes to support amend mtk aging algo features
	  Set No to disable OPLUS_CHARGER_MTKAGING features

config OPPO_HVDCP_SUPPORT
        bool "OPPO_HVDCP_SUPPORT"
        default n
        help
          Set yes to support hvdcp.

config OPLUS_CHECK_CHARGERID_VOLT
	bool "OPLUS_CHECK_CHARGERID_VOLT"
	default n
	help
	  Set yes to support OPLUS_CHECK_CHARGERID_VOLT features
	  smart battery.
	  Set No to disable OPLUS_CHECK_CHARGERID_VOLT features
	  smart battery.

config OPLUS_4400MV_BATTERY_SUPPORT
	bool "OPLUS_4400MV_BATTERY_SUPPORT"
	default n
	help
	  Set yes to support 4400MV BATTERY features
	  smart battery.
	  Set No to disable 4400MV BATTERY features
	  smart battery.

config OPLUS_CALL_MODE_SUPPORT
	bool "OPLUS call mode support"
	default n
	help
	  Say Y to enable support for the oppo call mode.

config OPLUS_SHIP_MODE_SUPPORT
	bool "OPLUS ship mode support"
	default n
	help
	  Say Y to include support

config OPLUS_SHORT_HW_CHECK
	bool "OPLUS batt HW SHORT"
	default n
	help
	  Say Y to include support

config OPLUS_SMART_CHARGER_SUPPORT
        bool "OPLUS Smart Charger support"
        default n
        help
          Say Y to include support

config OPLUS_DUAL_CHARGER_SUPPORT
	bool "OPLUS Dual Charger support"
	default n
	help
	  Say Y to include support

#endif /* OPLUS_FEATURE_CHG_BASIC */
```

## drivers/soc/Kconfig
```kconfig
menu "SOC (System On Chip) specific Drivers"

source "drivers/soc/actions/Kconfig"
source "drivers/soc/amlogic/Kconfig"
source "drivers/soc/atmel/Kconfig"
source "drivers/soc/bcm/Kconfig"
source "drivers/soc/fsl/Kconfig"
source "drivers/soc/imx/Kconfig"
source "drivers/soc/mediatek/Kconfig"
source "drivers/soc/qcom/Kconfig"
source "drivers/soc/renesas/Kconfig"
source "drivers/soc/rockchip/Kconfig"
source "drivers/soc/samsung/Kconfig"
source "drivers/soc/sunxi/Kconfig"
source "drivers/soc/tegra/Kconfig"
source "drivers/soc/ti/Kconfig"
source "drivers/soc/ux500/Kconfig"
source "drivers/soc/versatile/Kconfig"
source "drivers/soc/xilinx/Kconfig"
source "drivers/soc/zte/Kconfig"
#ifdef VENDOR_EDIT
source "drivers/soc/oppo/Kconfig"
#endif /*VENDOR_EDIT*/
#ifdef OPLUS_FEATURE_IOMONITOR
source "drivers/soc/oplus/iomonitor/Kconfig"
#endif /*OPLUS_FEATURE_IOMONITOR*/
#ifdef VENDOR_EDIT
source "drivers/soc/oplus/system/Kconfig"
#endif /* VENDOR_EDIT */
#ifdef VENDOR_EDIT
source "drivers/soc/oplus/oppo_healthinfo/Kconfig"
#endif

#ifdef OPLUS_FEATURE_LOWMEM_DBG
# Add for dump memory usage when lowmmem occurs.
source "drivers/soc/oplus/lowmem_dbg/Kconfig"
##endif /* OPLUS_FEATURE_LOWMEM_DBG */

#ifdef OPLUS_FEATURE_TP_BASIC
source "drivers/soc/oplus/Kconfig"
#endif /* OPLUS_FEATURE_TP_BASIC */
endmenu
```

## drivers/soc/oplus/Kconfig
```kconfig
#ifdef OPLUS_FEATURE_TP_BASIC
config OPPO_COMMON_SOFT
  bool "config oppo common software"
  select OPPO_ARCH_FILE
  help
        define this config to get project verion from sharemem.
        Maybe this value is from CDT or dynamic identify by hardware
        id.

config OPPO_DEVICE_IFNO
  bool "config oppo devinfo"
  select OPPO_ARCH_FILE
  help
        define this config to compile devinfo.c for device register

source "drivers/soc/oplus/device_info/Kconfig"
#endif /* OPLUS_FEATURE_TP_BASIC */

#ifdef OPLUS_FEATURE_MEMLEAK_DETECT
source "drivers/soc/oplus/svelte/Kconfig"
##endif /* OPLUS_FEATURE_MEMLEAK_DETECT */
```

## drivers/soc/oppo/Kconfig
```kconfig
#ifdef VENDOR_EDIT
config OPPO_ARCH_FILE
    bool "for build directory oppo"
    ---help---
    say Y to buid in

#ifdef OPLUS_FEATURE_NFC_CONSOFT
config OPPO_NFC
  bool "config oppo nfc chipset"
  select OPPO_ARCH_FILE
  help
	define this config to get nfc chipset version from dts.
#endif /* OPLUS_FEATURE_NFC_CONSOFT
#source "drivers/soc/oppo/oppo_devinfo/Kconfig"
source "drivers/soc/oppo/oppo_als_cali_value/Kconfig"
#source "drivers/soc/oppo/oppo_hypnus/Kconfig"
#//Wen.Luo@BSP
#source "drivers/soc/oppo/oppo_shutdown_detect/Kconfig"

#source "drivers/soc/oppo/oppo_phoenix/Kconfig"
#endif /* VENDOR_EDIT */

#ifdef VENDOR_EDIT
#source "drivers/soc/oppo/oppo_key_handle/Kconfig"
#endif /* VENDOR_EDIT */

#ifdef OPLUS_FEATURE_NFC_CONSOFT
source "drivers/soc/oppo/oppo_nfc/Kconfig"
#endif /* OPLUS_FEATURE_NFC_CONSOFT */
```
